## Kconfig
```kconfig
mainmenu "CViTek MediaSDK Configuration"

source "applications/Kconfig"
source "components/Kconfig"
source "app_services/Kconfig"

menu "OSS Configuration"
config OSS_AWTKCODE
	bool "OSS Awtkcode"
	help
		Say Y if you want to use OSS Awtkcode.

config OSS_FFMPEG
	bool "OSS FFMPEG"
	help
		Say Y if you want to use OSS FFMPEG.

config OSS_THTTPD
	bool "OSS THTTPD"
	help
		Say Y if you want to use OSS THTTPD.

config OSS_LVGL
	bool "OSS LVGL"
	help
		Say Y if you want to use OSS LVGL.

config COMPONENTS_KT_ANI_SDK
	bool "kt animal sdk"
	help
		Say Y if you want to use animal sdk.

endmenu

menu "Compiler Configuration"

menu "Chip Type"
	config CV184X
		bool "cv184X"
	config CV181X
		bool "cv181X"
endmenu

config CROSS_COMPILE
	string
	default "arm-none-linux-musleabihf-"
	prompt "Cross compile toolchain prefix for application"

config STATIC
	bool "Build static binary (no shared libs)"
	default n
	help
		If you want to build a static binary, which does not use
		or require any shared libraries, enable this option.
		Static binaries are larger, but do not require functioning
		dynamic libraries to be present, which is important if used
		as a system rescue tool.

endmenu

menu "CViTek Platform Configuration"
config CVI_PLATFORM_DIR
	string
	default "${SRCTREE}/.."
	prompt "Platform Path"
config CVI_BUILD_DIRNAME
	string
	default "cv1842hp_cardv_spinor"
	prompt "Platform Build DirName"
config KOMOD_PATH
	string
	default "/system/ko"
	prompt "Platform Ko Ptah"
endmenu

menu "Release Configuration"
config RELEASE_DEFCONFIG_FILE
	string
	default "cv1842cp_sm3_81_dc309_defconfig"
	prompt "Release defconfig file name"
	help
	  Specify the defconfig file name for release builds.
	  This file should be located in the configs/ directory.
endmenu
```

## app_services/Kconfig
```kconfig
menu "Services Configuration"

config SERVICES_AUDIO
	bool "Audio Service"
	help
		 Say Y if you want to enable Audio Rec Service

config SERVICES_IMAGE_VIEWER
	bool "Image_viewer Service"
	help
		 Say Y if you want to enable Image_viewer Rec Service

config SERVICES_LIVEVIEW
	bool "Liveview Service"
	help
		 Say Y if you want to enable Liveview Rec Service

config SERVICES_PLAYER
	bool "Player Service"
	help
		 Say Y if you want to enable Player Rec Service

if SERVICES_PLAYER

	config PLAYER_SUBVIDEO
	bool "Player Subvideo"
	help
		 Say Y if you want to enable Player Subvideo Service

endif

config SERVICES_RECORD
	bool "Record Service"
	help
		 Say Y if you want to enable Record Rec Service

if SERVICES_RECORD

	config SERVICES_SUBVIDEO
	bool "Rec/Rtsp Subvideo Service"
	help
		 Say Y if you want to enable Subvideo Rec/Rtsp Service

endif

config SERVICES_PHOTO
	bool "Photo Service"
	help
		 Say Y if you want to enable Photo Service

config SERVICES_RTSP
	bool "RTSP Service"
	help
		 Say Y if you want to enable RTSP Rec Service

if SERVICES_RTSP

config RTSP_NO_AUDIO
bool "Rtsp No Audio"
help
	Say Y if you want to enable Rtsp No Audio

endif

config ENABLE_SNAP
	bool "Snap Service"
	help
		 Say Y if you want to enable Snap Service

config SERVICES_STORAGE
	bool "Storage Service"
	help
		 Say Y if you want to enable Storage Rec Service

config SERVICES_MD
	bool "Motion Detect"
	help
		Say Y if you want to enable Motion Detect.

config SERVICES_FACEP
	bool "Face Process"
	help
		Say Y if you want to enable Face Process.

config SERVICES_ANIP
	bool "Animal Recognition Process"
	help
		Say Y if you want to enable Animal Recognition Process.

config SERVICES_SPEECH
	bool "Speech Service"
	help
		Say Y if you want to enable Service_Speech.

if SERVICES_SPEECH
	choice
		prompt "Model type"
		default SPEECH_CARDV


	config SPEECH_CARDV
		bool "Enable Speech Cardv"
		help
			Say Y if you want to enable Model Cardv.
	endchoice
endif

config SERVICES_ADAS
	bool "ADAS Service"
	help
		Say Y if you want to enable Service_ADAS.

if SERVICES_ADAS

	config ADAS_LABEL_CAR
		bool "Enabel ADAS CAR Label"
		help
		  Say Y if you want to enable ADAS CAR Label.

	config ADAS_LABEL_LANE
	bool "Enabel ADAS LANE Label"
	help
		Say Y if you want to enable ADAS LANE Label.

endif

config SERVICES_QRCODE
	bool "Decoding QRCode Service"
	help
		Say Y if you want to enable decoding QRCode
choice
	prompt "Dec QRCode Lib"
	default ZBAR
	depends on SERVICES_QRCODE
	config ZBAR
		bool "Zbar"
endchoice

endmenu
```
